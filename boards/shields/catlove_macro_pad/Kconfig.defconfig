## boards/shields/catlove_macro_pad/Kconfig.defconfig
```kconfig
if SHIELD_CATLOVE_MACRO_PAD

config ZMK_KEYBOARD_NAME
    default "Catlove Macro"

endif
```

## boards/shields/catlove_macro_pad/Kconfig.shield
```kconfig
config SHIELD_CATLOVE_MACRO_PAD
    def_bool $(shields_list_contains,catlove_macro_pad)
```

## boards/shields/catlove_macro_pad_oled/Kconfig.shield
```kconfig
config SHIELD_CATLOVE_MACRO_PAD_OLED
    def_bool $(shields_list_contains,catlove_macro_pad_oled)
```
